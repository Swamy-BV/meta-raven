## conf/layer.conf
```bitbake
BBPATH .= ":${LAYERDIR}"
BBFILES += "\
    ${LAYERDIR}/recipes-*/*/*.bb \
    ${LAYERDIR}/recipes-*/*/*.bbappend \
    ${LAYERDIR}/src/*/*/*.bb \
    ${LAYERDIR}/src/*/*/*.bbappend \
"
BBFILE_COLLECTIONS += "raven"
BBFILE_PATTERN_raven := "^${LAYERDIR}/"
BBFILE_PRIORITY_raven = "20"
LAYERSERIES_COMPAT_raven = "wrynose"
LAYERDEPENDS_raven = "\
    core \
    openembedded-layer \
    fsl-bsp-release \
    fsl-sdk-release \
    ros-common-layer \
    ros2-layer \
    ros2-jazzy-layer \
    swupdate \
    meta-freescale-ml \
    imx-machine-learning \
"
```

## meta-raven-bsp/conf/layer.conf
```bitbake
BBPATH .= ":${LAYERDIR}"
BBFILES += "${LAYERDIR}/recipes-*/*/*.bb ${LAYERDIR}/recipes-*/*/*.bbappend"
BBFILE_COLLECTIONS += "raven-bsp"
BBFILE_PATTERN_raven-bsp := "^${LAYERDIR}/"
BBFILE_PRIORITY_raven-bsp = "20"
LAYERSERIES_COMPAT_raven-bsp = "wrynose"
LAYERDEPENDS_raven-bsp = "core fsl-bsp-release"
```

## meta-raven-sdk/conf/layer.conf
```bitbake
BBPATH .= ":${LAYERDIR}"
BBFILES += "${LAYERDIR}/recipes-*/*/*.bb ${LAYERDIR}/recipes-*/*/*.bbappend"
BBFILE_COLLECTIONS += "raven-sdk"
BBFILE_PATTERN_raven-sdk := "^${LAYERDIR}/"
BBFILE_PRIORITY_raven-sdk = "20"
LAYERSERIES_COMPAT_raven-sdk = "wrynose"
LAYERDEPENDS_raven-sdk = "core raven-bsp fsl-sdk-release ros-common-layer ros2-layer ros2-jazzy-layer"
```
